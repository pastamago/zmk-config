## boards/shields/jellyfish_39/Kconfig.defconfig
```kconfig
if SHIELD_JELLYFISH_39

config ZMK_KEYBOARD_NAME
    default "Jellyfish_39"

endif # SHIELD_JELLYFISH_39
```

## boards/shields/jellyfish_39/Kconfig.shield
```kconfig
config SHIELD_JELLYFISH_39_LEFT
    def_bool $(shields_list_contains,jellyfish_39_left)

config SHIELD_JELLYFISH_39_RIGHT
    def_bool $(shields_list_contains,jellyfish_39_right)
```

## boards/shields/jellyfish_split/Kconfig.defconfig
```kconfig
if SHIELD_JELLYFISH_SPLIT

config ZMK_KEYBOARD_NAME
    default "Jellyfish_Split"

endif # SHIELD_JELLYFISH_SPLIT
```

## boards/shields/jellyfish_split/Kconfig.shield
```kconfig
config SHIELD_JELLYFISH_split_LEFT
    def_bool $(shields_list_contains,jellyfish_split_left)

config SHIELD_JELLYFISH_split_RIGHT
    def_bool $(shields_list_contains,jellyfish_split_right)
```
