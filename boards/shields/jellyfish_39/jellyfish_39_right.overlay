// This file was generated from a template. Edit it to match your keyboard.
// See https://zmk.dev/docs/development/hardware-integration/new-shield for more
// instructions.

#include "jellyfish_39.overlay"

&default_transform {
    col-offset = <7>;
};

&kscan0 {
    compatible = "zmk,kscan-gpio-matrix";
    diode-direction = "col2row";
    
    row-gpios
        = <&gpio0 15 (GPIO_ACTIVE_LOW | GPIO_PULL_UP)>
        , <&gpio0 19 (GPIO_ACTIVE_LOW | GPIO_PULL_UP)>
        , <&gpio1 1  (GPIO_ACTIVE_LOW | GPIO_PULL_UP)>
        , <&gpio0 9  (GPIO_ACTIVE_LOW | GPIO_PULL_UP)>
        , <&gpio0 10 (GPIO_ACTIVE_LOW | GPIO_PULL_UP)>
        ;

    col-gpios
        = <&gpio0 4  GPIO_ACTIVE_LOW>
        , <&gpio0 5  GPIO_ACTIVE_LOW>
        , <&gpio1 11 GPIO_ACTIVE_LOW>
        , <&gpio1 12 GPIO_ACTIVE_LOW>
        , <&gpio1 13 GPIO_ACTIVE_LOW>
        , <&gpio1 14 GPIO_ACTIVE_LOW>
        , <&gpio1 15 GPIO_ACTIVE_LOW>
        ;
};